## conf/layer.conf
```bitbake
# We have a conf and classes directory, add to BBPATH
BBPATH .= ":${LAYERDIR}"

# We have recipes-* directories, add to BBFILES
BBFILES += "${LAYERDIR}/recipes-*/*/*.bb \
            ${LAYERDIR}/recipes-*/*/*.bbappend"

BBFILE_COLLECTIONS += "seeed-st-odyssey"
BBFILE_PATTERN_seeed-st-odyssey = "^${LAYERDIR}/"
BBFILE_PRIORITY_seeed-st-odyssey = "7"

EULA_FILE_ST:stm32mp157c-odyssey = "${LAYERDIR}/conf/eula/${MACHINE}"
EULA_FILE_ST_MD5SUM:stm32mp157c-odyssey = "8b505090fb679839cefbcc784afe8ce9"

LICENSE_PATH += "${LAYERDIR}/files/licenses"

LAYERVERSION_seeed-st-odyssey = "1"
LAYERSERIES_COMPAT_seeed-st-odyssey = "kirkstone"

LAYERDEPENDS_seeed-st-odyssey = "core stm-st-stm32mp"

# OpenSTLinux compatibility version
ST_OSTL_COMPATIBILTY_VERSION_seeed-st-odyssey = "4.0"
```

## conf/machine/include/seeed-machine-common-stm32mp.inc
```bitbake
#@DESCRIPTION: Common Machine configuration for STM32 systems

# Define specific common layer name
MACHINEOVERRIDES .= ":stm32mp157c-odyssey"

# =========================================================================
# boot scheme
# =========================================================================
# List of supported boot schemes
BOOTSCHEME_LABELS ?= "trusted optee"

# =========================================================================
# boot device
# =========================================================================
BOOTDEVICE_LABELS ?= "emmc sdcard"

UBOOT_CONFIG:append:stm32mp157c-odyssey = " ${@bb.utils.contains_any('BOOTSCHEME_LABELS', 'optee trusted', 'trusted_stm32mp15', '', d)} "

# =========================================================================
# optee
# =========================================================================
# Map OPTEE configuration to device tree list
OPTEE_CONF = "${STM32MP_DEVICETREE}"

# =========================================================================
# Machine settings
# =========================================================================
STM32MP_DEVICETREE:append = "${STM32MP_DT_FILES_ODYSSEY}"

IMAGE_FSTYPES:remove = "tar.xz"


# =========================================================================
# Device Storage
# =========================================================================
# Enable the board device storage support with STM32MP_DT_FILES_ODYSSEY according to BOOTDEVICE_LABELS
DEVICE_BOARD_ENABLE:EMMC    += "${@bb.utils.contains('BOOTDEVICE_LABELS', 'emmc', '${STM32MP_DT_FILES_ODYSSEY}', '', d)}"
DEVICE_BOARD_ENABLE:SDCARD  += "${@bb.utils.contains('BOOTDEVICE_LABELS', 'sdcard', '${STM32MP_DT_FILES_ODYSSEY}', '', d)}"

# =========================================================================
# Flashlayout
# =========================================================================
# Set the FLASHLAYOUT_TYPE_LABELS to STM32MP_DT_FILES_ODYSSEY according to BOOTDEVICE_LABELS
FLASHLAYOUT_TYPE_LABELS:emmc        = "${@bb.utils.contains('BOOTDEVICE_LABELS', 'emmc', '${STM32MP_DT_FILES_ODYSSEY}', '', d)}"
FLASHLAYOUT_TYPE_LABELS:sdcard      = "${@bb.utils.contains('BOOTDEVICE_LABELS', 'sdcard', '${STM32MP_DT_FILES_ODYSSEY}', '', d)}"

# Specific settings for 'extensible' and 'deleteall' configurations
FLASHLAYOUT_CONFIG_LABELS:deleteall = "cubemx"
FLASHLAYOUT_TYPE_LABELS:deleteall:cubemx = "${STM32MP_DT_FILES_ODYSSEY}"
FLASHLAYOUT_TYPE_LABELS:extensible = "${STM32MP_DT_FILES_ODYSSEY}"
```

## conf/machine/stm32mp157c-odyssey.conf
```bitbake
#@TYPE: Machine
#@NAME: stm32mp157c-odyssey
#@DESCRIPTION: Seeed Studios STM32MP157C Odyssey
#@NEEDED_BSPLAYERS:

include conf/machine/include/st-machine-common-stm32mp.inc
include conf/machine/include/st-machine-providers-stm32mp.inc

MACHINEOVERRIDES .= ":stcommon"
MACHINEOVERRIDES .= ":stm32mpcommon"
MACHINEOVERRIDES .= ":stm32mp1common"
MACHINEOVERRIDES .= ":stm32mp157c-odyssey"


# =========================================================================
# SOC
# =========================================================================
STM32MP_SOC_NAME = ""
STM32MP_SOC_NAME:append:stm32mp157c-odyssey = " stm32mp157c "
# Take care of nativesdk override use case
STM32MP_SOC_NAME:append:class-nativesdk = " stm32mp15 "


# =========================================================================
# Chip architecture
# =========================================================================
DEFAULTTUNE = "cortexa7thf-neon-vfpv4"
include conf/machine/include/arm/armv7a/tune-cortexa7.inc


# =========================================================================
# boot scheme
# =========================================================================
#BOOTSCHEME_LABELS = "basic"
BOOTSCHEME_LABELS += "trusted"
#BOOTSCHEME_LABELS += "optee"


# =========================================================================
# boot device
# =========================================================================
# Define the boot device supported
#BOOTDEVICE_LABELS += "emmc"
BOOTDEVICE_LABELS += "sdcard"


# =========================================================================
# Machine settings
# =========================================================================
# Define list of devicetree per board
STM32MP_DT_FILES_ODYSSEY += "stm32mp157c-odyssey"
STM32MP_DEVICETREE:append = "${STM32MP_DT_FILES_ODYSSEY}"
IMAGE_FSTYPES:remove = "tar.xz"


# =========================================================================
# Machine features
# =========================================================================
#MACHINE_FEATURES += "bluetooth"
MACHINE_FEATURES += "watchdog"
#MACHINE_FEATURES += "wifi"
MACHINE_FEATURES += "${@'gpu' if d.getVar('ACCEPT_EULA_'+d.getVar('MACHINE')) == '1' else ''}"
# Splashscreen enabled
MACHINE_FEATURES += "splashscreen"
#MACHINE_FEATURES += "m4copro"


# =========================================================================
# Kernel
# =========================================================================
#KERNEL_MODULE_AUTOLOAD = "edt-ft5x06"
#KERNEL_MODULE_AUTOLOAD += "goodix"
#KERNEL_MODULE_AUTOLOAD += "tsc2007"

# Define the devicetree for Linux A7 examples
#LINUX_A7_EXAMPLES_DT += "stm32mp157c-odyssey-a7examples"


# =========================================================================
# u-boot
# =========================================================================

# Define default U-Boot config
UBOOT_CONFIG:append = " ${@bb.utils.contains_any('BOOTSCHEME_LABELS', 'optee trusted', 'trusted_stm32mp157c_odyssey', '', d)} "
UBOOT_CONFIG[trusted_stm32mp157c_odyssey] = "stm32mp157c_odyssey_defconfig,,u-boot.dtb"


# =========================================================================
# M4 copro
# =========================================================================
# Define the devicetree for M4 example
#CUBE_M4_EXAMPLES_DT += "stm32mp157c-odyssey-m4-examples"

# Define specific board reference to use
#M4_BOARDS = "STM32MP157C-ODYSSEY"


# =========================================================================
# extlinux configuration
# =========================================================================
# As example, modify the default boot config to M4 config
#UBOOT_EXTLINUX_DEFAULT_LABEL_stm32mp157c-odyssey = "stm32mp157c-odyssey-m4-examples"
UBOOT_EXTLINUX_TARGETS_EXTRA_CONFIG:target-sdcard += "${STM32MP_DT_FILES_ODYSSEY}"
UBOOT_EXTLINUX_TARGETS_EXTRA_CONFIG:target-emmc += "${STM32MP_DT_FILES_ODYSSEY}"

ST_VENDORFS = "0"
ST_USERFS   = "0"

# =========================================================================
# WIC for sdcard raw image
# =========================================================================
WIC_CREATE_EXTRA_ARGS = "--no-fstab-update"
WKS_FILE_DEPENDS ?= " \
   virtual/bootloader \
   virtual/trusted-firmware-a \
   ${@bb.utils.contains('BOOTSCHEME_LABELS', 'optee', 'virtual/optee-os', '', d)} \
   st-image-bootfs \
   ${@bb.utils.contains('ST_VENDORFS','1','st-image-vendorfs', '', d)} \
   st-image-userfs \
"
TRUSTED_WIC_FILE = "${@bb.utils.contains('ST_VENDORFS','1','sdcard-stm32mp157c-odyssey-trusted-vendorfs-1GB.wks.in','sdcard-stm32mp157c-odyssey-trusted-1GB.wks.in',d)}"
OPTEE_WIC_FILE = "${@bb.utils.contains('ST_VENDORFS','1','sdcard-stm32mp157c-odyssey-optee-vendorfs-1GB.wks.in','sdcard-stm32mp157c-odyssey-optee-1GB.wks.in',d)}"

# for generated a WIC file, please uncomment the 2 following lines or add them to local.conf
WKS_IMAGE_FSTYPES += "wic wic.lz4 wic.bmap"
WKS_FILE += "${@bb.utils.contains('BOOTSCHEME_LABELS', 'optee', '${OPTEE_WIC_FILE}', '${TRUSTED_WIC_FILE}', d)}"
```
